## sdkconfig.defaults
```kconfig
# ESP32 target (M5StickC Plus2 uses ESP32-PICO-V3-02)
CONFIG_IDF_TARGET="esp32"

# BLE: Use Bluedroid (more stable, better documented)
CONFIG_BT_ENABLED=y
CONFIG_BT_BLUEDROID_ENABLED=y
CONFIG_BT_CONTROLLER_MODE_BLE_ONLY=y

# Disable NimBLE
CONFIG_BT_NIMBLE_ENABLED=n

# NimBLE configuration
CONFIG_BT_NIMBLE_ROLE_CENTRAL=y
CONFIG_BT_NIMBLE_ROLE_PERIPHERAL=n
CONFIG_BT_NIMBLE_ROLE_BROADCASTER=n
CONFIG_BT_NIMBLE_ROLE_OBSERVER=y
CONFIG_BT_NIMBLE_MAX_CONNECTIONS=1

# SPI for LCD (ST7789V2 on M5StickC Plus2)
CONFIG_SPI_MASTER_ISR_IN_IRAM=y

# Log level
CONFIG_LOG_DEFAULT_LEVEL_INFO=y

# Stack sizes
CONFIG_ESP_MAIN_TASK_STACK_SIZE=8192
```
